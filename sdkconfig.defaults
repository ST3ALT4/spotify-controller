## sdkconfig.defaults
```kconfig
# Flash size & partition table
CONFIG_ESPTOOLPY_FLASHSIZE_4MB=y
CONFIG_PARTITION_TABLE_CUSTOM=y
CONFIG_PARTITION_TABLE_CUSTOM_FILENAME="partitions.csv"
CONFIG_PARTITION_TABLE_FILENAME="partitions.csv"

# Main task stack size
CONFIG_ESP_MAIN_TASK_STACK_SIZE=8192

# Enable C++ exceptions and RTTI if needed
CONFIG_COMPILER_CXX_EXCEPTIONS=y

# FreeRTOS
CONFIG_FREERTOS_HZ=1000

# mbedTLS
CONFIG_MBEDTLS_DYNAMIC_BUFFER=y
CONFIG_MBEDTLS_DYNAMIC_FREE_CONFIG_DATA=y
CONFIG_MBEDTLS_DYNAMIC_FREE_PEER_CERT=y

# HTTP client
CONFIG_ESP_HTTP_CLIENT_ENABLE_HTTPS=y
```
